## conf/layer.conf
```bitbake
BBPATH .= ":${LAYERDIR}"
BBFILES += "${LAYERDIR}/recipes*/*/*.bb ${LAYERDIR}/recipes*/*/*.bbappend"
BBFILE_COLLECTIONS += "meta-csdr"
BBFILE_PATTERN_meta-csdr := "^${LAYERDIR}/"
BBFILE_PRIORITY_meta-csdr = "90"
```
